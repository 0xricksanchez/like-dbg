## examples/c_kmod/echo_service/Kconfig
```kconfig
# This is to be placed in drivers/misc/Kconfig
config LIKEDBG_ECHO_DEMO
    tristate "A Simple echo service module"
    default y
    help
        This enables the echo module.
```

## examples/legacy-intree/ioctl_test_drv/Kconfig
```kconfig
# This is to be placed in drivers/misc/Kconfig
config LIKEDBG_IOCTL_DEMO
    tristate "A Simple ioctl service module"
    default y
    help
        This enables the ioctl module.
```
